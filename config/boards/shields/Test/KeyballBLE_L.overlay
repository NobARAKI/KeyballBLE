/* KeyballBLE_L.overlay */
#include "KeyballBLE.dtsi"

/* 左手側：エンコーダを有効化 */
&left_encoder {
    status = "okay";
};

/* 左手側：トラックボールは存在しないので無効化（D0ピンをエンコーダに譲るため必須） */
&trackball {
    status = "disabled";
};

&kscan0 {
    /* 左手側はピンに余裕があるため、NFC Pad 1 (P0.09) を6列目として使用 */
    col-gpios
        = <&xiao_d 10 GPIO_ACTIVE_HIGH>
        , <&xiao_d 9 GPIO_ACTIVE_HIGH> 
        , <&xiao_d 8 GPIO_ACTIVE_HIGH> 
        , <&xiao_d 7 GPIO_ACTIVE_HIGH> 
        , <&gpio0 10 GPIO_ACTIVE_HIGH> // NFC Pad 2
        , <&gpio0 9 GPIO_ACTIVE_HIGH>  // NFC Pad 1 (左手専用の列)
        ;
};